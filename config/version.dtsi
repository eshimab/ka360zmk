#define VERSION_MACRO
macro_ver: macro_ver {
compatible = "zmk,behavior-macro";
label = "macro_ver";
#binding-cells = <0>;
bindings = <&kp N2>, <&kp N0>, <&kp N2>, <&kp N6>, <&kp N0>, <&kp N1>, <&kp N1>, <&kp N4>, <&kp MINUS>, <&kp P>, <&kp R>, <&kp O>, <&kp D>, <&kp MINUS>, <&kp N8>, <&kp N0>, <&kp A>, <&kp N4>, <&kp E>, <&kp C>, <&kp E>, <&kp RET>;
};
